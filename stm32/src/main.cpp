#include <Arduino.h>

//    Draw direction    ────►

// │  ┌─────────────────────────────┐
// │  │ ▲                           │
// │  │◄┌──────────320─────────────►│
// │  │ │                           │
// ▼  │ 2                           │
//    │ 4        DISPLAY            │
//    │ 0                           │
//    │ │                   ┌────┐  │
//    │ │                   └────┘  │
//    │ ▼                           │
//    └─────────────────────────────┘



//   drawByte ────────► 10101010


const uint8_t VCLK = PB9; 
const uint8_t HS = PB0; 
const uint8_t VS = PB7;

const uint8_t VID0 = PB3;
const uint8_t VID1 = PB4;
const uint8_t VID2 = PB5;
const uint8_t VID3 = PB6;

const u_int16_t maxX = 320;
const u_int16_t maxY = 240;

u_int16_t currX = 0;
u_int16_t currY = 0;

// '1', 320x240px
const u_int8_t epd_bitmap_1 [] PROGMEM = {
	0xff, 0xff, 0xff, 0xff, 0xff, 0xff, 0xff, 0xff, 0xff, 0xff, 0xff, 0xff, 0xff, 0xff, 0xff, 0xff, 
	0xff, 0xff, 0xff, 0xff, 0xff, 0xff, 0xff, 0xff, 0xff, 0xff, 0xff, 0xff, 0xff, 0xff, 0xff, 0xff, 
	0xff, 0xff, 0xff, 0xff, 0xff, 0xff, 0xff, 0xff, 0xff, 0xff, 0xff, 0xff, 0xff, 0xff, 0xff, 0xff, 
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	0xff, 0xff, 0xff, 0xff, 0xff, 0xff, 0xff, 0xff, 0xff, 0xff, 0xff, 0xff, 0xff, 0xff, 0xff, 0xff
};



void drawByte(uint8_t input);
void setup() {
  pinMode(VCLK, OUTPUT);
  pinMode(HS, OUTPUT);
  pinMode(VS, OUTPUT);

  pinMode(VID0, OUTPUT);
  pinMode(VID1, OUTPUT);
  pinMode(VID2, OUTPUT);
  pinMode(VID3, OUTPUT);

}
bool st = false;

void loop() {

  while(1){
    for(uint16_t i = 0; i < sizeof(epd_bitmap_1)/sizeof(u_int8_t); i++){
      drawByte(epd_bitmap_1[i]);
    }
  }

}
void drawByte(uint8_t input){
uint8_t drawRight = input & 0b00001111;
uint8_t drawLeft = input & 0b11110000;

uint8_t buff = 0;
uint16_t toDraw = 0; 
uint16_t toDrawInv = 0;

buff = drawLeft >> 1;
toDraw = buff & 0b0000000001111000;
toDrawInv = ~toDraw ^ ~0b0000000001111000;
GPIOB->BSRR = toDraw;
GPIOB->BSRR = toDrawInv << 16;	// put 4 bits of data on the data pins
currX += 4;	// increment currecnt position counter

GPIOB->BSRR = 0b0000001000000000; //set PB9(VCLK) only to HIGH  
GPIOB->BSRR = 0b0000001000000000 << 16; //set PB9(VCLK) only to LOW 

  if(currX >= maxX){
    currX = 0;
    currY += 1;
    if(currY >= maxY){	// if the end if the display was reached pulse vertical and horizontal sync
      GPIOB->BSRR = 0b0000000010000000; //set PB7(VS) only to HIGH
      GPIOB->BSRR = 0b0000000000000001; //set PB0(HS) only to HIGH
      GPIOB->BSRR = 0b0000000000000001 << 16; //set PB0(HS) only to LOW
      GPIOB->BSRR = 0b0000000010000000 << 16; //set PB7(VS) only to LOW
      currY = 0;
      st = !st;
    }else{	// if we just reached the end of the X line pulse the horizontal sync line
      GPIOB->BSRR = 0b0000000000000001; //set PB0(HS) only to HIGH
      GPIOB->BSRR = 0b0000000000000001 << 16; //set PB0(HS) only to LOW
      st = !st;
    }
  }

// the same but for the second part of the byte
buff = drawRight << 3;
toDraw = buff & 0b0000000001111000;
toDrawInv = ~toDraw ^ ~0b0000000001111000;
GPIOB->BSRR = toDraw;
GPIOB->BSRR = toDrawInv << 16;
currX += 4;

GPIOB->BSRR = 0b0000001000000000; //set PB9(VCLK) only to HIGH  
GPIOB->BSRR = 0b0000001000000000 << 16; //set PB9(VCLK) only to LOW 

  if(currX >= maxX){
    currX = 0;
    currY += 1;
    if(currY >= maxY){
      GPIOB->BSRR = 0b0000000010000000; //set PB7(VS) only to HIGH
      GPIOB->BSRR = 0b0000000000000001; //set PB0(HS) only to HIGH
      GPIOB->BSRR = 0b0000000000000001 << 16; //set PB0(HS) only to LOW
      GPIOB->BSRR = 0b0000000010000000 << 16; //set PB7(VS) only to LOW
      currY = 0;
      st = !st;
    }else{
      GPIOB->BSRR = 0b0000000000000001; //set PB0(HS) only to HIGH
      GPIOB->BSRR = 0b0000000000000001 << 16; //set PB0(HS) only to LOW
      st = !st;
    }
  }

}
